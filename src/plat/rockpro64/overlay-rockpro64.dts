/*
 * Copyright 2020, Data61, CSIRO (ABN 41 687 119 230)
 * Copyright 2021, HENSOLDT Cyber
 *
 * SPDX-License-Identifier: GPL-2.0-only
 */

/ {
	chosen {
		seL4,elfloader-devices =
		    "serial2",
		    &{/psci},
		    &{/timer};
		seL4,kernel-devices =
		    "serial2",
		    &{/interrupt-controller@fee00000},
		    &{/timer};
	};

    reserved-memory {
        #address-cells = <0x01>;
        #size-cells = <0x01>;
        ranges;

        /*
         * Reserve 2 MiB for SBI at the start of RAM (0x80000000 - 0x80200000).
         * This is exactly one "megapage" in the MMU table.
         */
        sbi@80000000 {
            reg = <0x80000000 0x200000>;
            no-map;
        };
    };
};
